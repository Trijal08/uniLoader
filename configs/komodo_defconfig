## configs/komodo_defconfig
```kconfig
CONFIG_POSITION_INDEPENDENT=y
CONFIG_LINUX_KRNL_HEADER_IMG=y
# CONFIG_COMPRESS_GZIP is not set
CONFIG_COMPRESS_LZ4=y
CONFIG_EARLYCON=y
CONFIG_FDT_BUF_SIZE=1000000
CONFIG_EXYNOS_GOOGLE_ZUMA=y
CONFIG_TEXT_BASE=0xa0011010
CONFIG_PAYLOAD_ENTRY=0x80000000
CONFIG_RAMDISK_ENTRY=0x8d000000
```

## configs/n69_defconfig
```kconfig
CONFIG_POSITION_INDEPENDENT=y
CONFIG_APPLE_N69=y
CONFIG_TEXT_BASE=0x805e00000
CONFIG_PAYLOAD_ENTRY=0x840000000
CONFIG_RAMDISK_ENTRY=0x845000000
```

## configs/sky_defconfig
```kconfig
CONFIG_POSITION_INDEPENDENT=y
CONFIG_LINUX_KRNL_HEADER_IMG=y
# CONFIG_COMPRESS_GZIP is not set
CONFIG_FDT_BUF_SIZE=1000000
CONFIG_REDOX_BOOT=y
CONFIG_SM4450=y
CONFIG_XIAOMI_SKY=y
CONFIG_PAYLOAD_ENTRY=0xf1300000
CONFIG_RAMDISK_ENTRY=0xf7300000
```

## configs/tokay_defconfig
```kconfig
CONFIG_POSITION_INDEPENDENT=y
CONFIG_LINUX_KRNL_HEADER_IMG=y
# CONFIG_COMPRESS_GZIP is not set
CONFIG_COMPRESS_LZ4=y
CONFIG_FDT_BUF_SIZE=1000000
CONFIG_EXYNOS_GOOGLE_ZUMA=y
CONFIG_GOOGLE_TOKAY=y
CONFIG_TEXT_BASE=0xa0011010
CONFIG_PAYLOAD_ENTRY=0x890000000
CONFIG_RAMDISK_ENTRY=0x906000000
```
